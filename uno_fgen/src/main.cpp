/**
 * I2C/IIC LCD Serial Adapter Module Example
 * Tutorial by http://mklec.com
 *
 * Instructions at http://blog.mklec.com/how-to-use-iici2c-serial-interface-module-for-1602-lcd-display
 *
 * This uses the Liquid Crystal library from https://bitbucket.org/fmalpartida/new-liquidcrystal/downloads GNU General Public License, version 3 (GPL-3.0)
 * Pin Connections:
 *      SCL = A5
 *      SDA = A4
 *      VCC = 5V
 *      GND = GND
 */
#include <Arduino.h>
#include <Wire.h>
#include <LCD.h>
#include <LiquidCrystal_I2C.h>
#include <String.h>

LiquidCrystal_I2C  lcd(0x27,2,1, 0, 4, 5, 6, 7); // 0x27 is the I2C bus address for an unmodified module

#define FREQSET A0
#define BUTTON A3
#define ENCA A2
#define ENCB A1

byte outSample = 0;
double triInc;
byte sawInc;
byte newVal;


//variables for freq pot monitoring
int frequency = 5;

volatile word t = 0;
int samplerate = 25000;  // 1/4 of actual samplerate since only 1/4 wavelength of LUT defined
int numPeriods;

int sinIndex = 0; // current index in LUT
int range = 0;
int type = 1; // default to sine
int buttState;
int oldButtState;
int aState;
int bState;
int oldaState;
int quadrant = 0;
char buf[16];
char fBuf[7];
const char *output = "Frequency: \0";

const byte sinLUT[] PROGMEM = {0, 0, 0, 0, 0, 0, 0, 0, 0, 0, 0, 0, 0,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 8,
                                8, 8, 8, 8, 8, 8, 8, 8, 8, 8, 8, 8,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 16,
                                16, 16, 16, 16, 16, 16, 16, 16, 16, 16, 16, 16,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 23,
                                23, 24, 24, 24, 24, 24, 24, 24, 24, 24, 24, 24,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 31,
                                31, 31, 31, 31, 31, 31, 31, 31, 31, 31, 31, 31,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 39,
                                39, 39, 39, 39, 39, 39, 39, 39, 39, 39, 39, 39,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 47,
                                47, 47, 47, 47, 47, 47, 47, 47, 47, 47, 47, 47,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 54,
                                54, 54, 54, 54, 54, 54, 54, 54, 54, 54, 54, 54,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 61,
                                61, 61, 61, 61, 61, 61, 61, 61, 61, 61, 61, 61,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 68,
                                68, 68, 68, 68, 68, 68, 68, 68, 68, 68, 68, 68,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 75,
                                75, 75, 75, 75, 75, 75, 75, 75, 75, 75, 75, 75,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 81,
                                81, 81, 81, 81, 81, 81, 81, 81, 81, 81, 81, 81,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 87,
                                87, 87, 87, 87, 87, 87, 87, 87, 87, 87, 87, 87,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 93,
                                93, 93, 93, 93, 93, 93, 93, 93, 93, 93, 93, 93,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 98,
                                98, 98, 98, 98, 98, 98, 98, 98, 98, 98, 98, 98,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 103,
                                103, 103, 103, 103, 103, 103, 103, 103, 103, 103, 103, 103,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 108,
                                108, 108, 108, 108, 108, 108, 108, 108, 108, 108, 108, 108,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 112,
                                112, 112, 112, 112, 112, 112, 112, 112, 112, 112, 112, 112,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 115,
                                115, 115, 115, 115, 115, 115, 115, 115, 115, 115, 115, 115,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 119,
                                119, 119, 119, 119, 119, 119, 119, 119, 119, 119, 119, 119,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 121,
                                121, 121, 121, 121, 121, 121, 121, 121, 121, 121, 121, 121,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 123,
                                123, 123, 123, 123, 123, 123, 123, 123, 123, 123, 124, 124,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 125,
                                125, 125, 125, 125, 125, 125, 125, 125, 125, 125, 125, 125,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 126,
                                126, 126, 126, 126, 126, 126, 126, 126, 126, 127, 127, 127,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 127,
                                127, 127, 127, 127, 127, 127, 127, 127, 127, 127, 127, 127,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 127, };

const byte reverse[] PROGMEM = {0, 128, 64, 192, 32, 160, 96, 224, 16, 144, 80, 208, 48,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 127, 255};


/*byte reverse(byte b) {
   b = (b & 0xF0) >> 4 | (b & 0x0F) << 4;
   b = (b & 0xCC) >> 2 | (b & 0x33) << 2;
   b = (b & 0xAA) >> 1 | (b & 0x55) << 1;
   return b;
}*/

void updateLcdFunction(){
  lcd.setCursor(0,1);
  switch(type){
    case 0:
      lcd.print("Square Wave");
      break;
    case 1:
      lcd.print("Sinusoid    ");
      break;
    case 2:
      lcd.print("Triangle     ");
      break;
  }
}

void updateLcdFrequency(){
  lcd.setCursor(0,0);
  lcd.print(output);
  lcd.print(frequency);
  lcd.print("    ");
}

void freqCalc(){
  if (frequency < 25){
    range = 0;
  }
  else if (frequency < 250){
    range = 1;
  }
  else{
    range = 2;
  }
  triInc = 255.0/double(samplerate);
  sinIndex = (samplerate%frequency)/frequency;
  updateLcdFrequency();
}

bool buttonRead(){
  buttState = digitalRead(BUTTON);
  if (buttState == LOW){
    type += 1;
    type = type%3;
    oldButtState = buttState;
    delay(300);
    return true;
  }
  else{
    return false;
  }
}

void getFreq(){
  bool changing = true;
  while (changing){
    oldaState = aState;
    if (digitalRead(ENCB) != aState){ // a changes to stop matching b when clockwise, freq++
      switch(range){
        case(0):
          frequency = frequency + 1;
          break;
        case(1):
          frequency = frequency + 5;
          break;
        case(2):
          frequency = frequency + 10;
          break;
      }
      if (frequency > 5000){
        frequency = 5000;
      }
    }
    else{ // counterclockwise, freq--
      switch(range){
        case(0):
          frequency = frequency - 1;
          break;
        case(1):
          frequency = frequency - 5;
          break;
        case(2):
          frequency = frequency - 10;
          break;
      }
      if (frequency < 1){
        frequency = 1;
      }
    }
    freqCalc();
    aState = digitalRead(ENCA);
    if (aState == oldaState){
      changing = false;
    }
  }
}

void holdInts(){
  TCCR1A = 0;// set entire TCCR1A register to 0
  TCCR1B = 0;// same for TCCR1B
}
void setInts(){
//timer 1 controls sample output @ 100kHz
  holdInts();
  
  TCCR1B = 0;
  //turn on CTC mode and
  // Set CS10 bit for 0 prescaler
  TCCR1B |=  (1 << WGM12); 
  TCCR1B |=  (0 << CS10);
  TCCR1B |=  (1 << CS11);
  // enable timer compare interrupt
  TIMSK1 |= (1 << OCIE1A); 
  // enable overflow interrupt
  
  //set compare match register- 100khz for output sampling
  OCR1A = 19; // = (16 000 000 / 100 000) - 1 = 159
  TCNT1 = 0;
}

void setup()
{
  //initialize variables
  pinMode(BUTTON, INPUT_PULLUP);
  pinMode(ENCA, INPUT_PULLUP);
  pinMode(ENCB, INPUT_PULLUP);
  
  oldButtState = digitalRead(BUTTON);
  oldaState = digitalRead(ENCA);
  
  
  lcd.setBacklightPin(3,POSITIVE);
  lcd.setBacklight(HIGH); // NOTE: You can turn the backlight off by setting it to LOW instead of HIGH
  lcd.begin(16, 2);
  
  delay(15);
  
    //set port/pin  mode
  DDRD = 0xFF; //all outputs on port D (digital 0-7)
  PORTD = 0xFF;

  //TIMER INTERRUPT SETUP
  
  cli();
  holdInts();
  sei();
  updateLcdFunction();
  delay(10);
  freqCalc();
  delay(10);
  cli();
  setInts();
  sei();
  
}

  // calculate sinIndex here
byte newAnalogValue(){
  switch (type){
    case 0: // square wave
      if (quadrant < 2){
        return 0xFF;
      }
      else{
        return 0x00;
      }
      break;
    case 1: // sine
      switch (quadrant){
        case 0:
          return pgm_read_byte(&reverse[0x80 + pgm_read_byte(&sinLUT[sinIndex])]);
        case 1:
          return pgm_read_byte(&reverse[0x80 + pgm_read_byte(&sinLUT[24999 - sinIndex])]);
        case 2:
          return pgm_read_byte(&reverse[0x7F - pgm_read_byte(&sinLUT[sinIndex])]);
        case 3:
          return pgm_read_byte(&reverse[0x7F - pgm_read_byte(&sinLUT[24999 - sinIndex])]);
        }
    case 2: // triangle
      switch(quadrant){
        case 0:
          return pgm_read_byte(&reverse[0x80 + int(sinIndex * triInc)]);
        case 1:
          return pgm_read_byte(&reverse[0xFF - int(sinIndex * triInc)]);
        case 2:
          return pgm_read_byte(&reverse[0x7F - int(sinIndex * triInc)]);
        case 3:
          return pgm_read_byte(&reverse[int(sinIndex * triInc)]);
        }
    default: 
      return 0xFF;
  }
}


ISR(TIMER1_COMPA_vect){
  sinIndex += frequency;
  if (sinIndex >= samplerate){
    sinIndex = sinIndex - samplerate;
    quadrant++;
    quadrant %= 4;
  }

  // PORTD = newAnalogValue();
  
  switch (type){
    case 0: // square wave
      if (quadrant < 2){
        PORTD = 0xFF;
      }
      else{
        PORTD = 0x00;
      }
      break;
    case 1: // sine
      switch (quadrant){
        case 0:
          PORTD = pgm_read_byte(&reverse[0x7F + pgm_read_byte(&sinLUT[sinIndex])]);
          break;
        case 1:
          PORTD = pgm_read_byte(&reverse[0x7F + pgm_read_byte(&sinLUT[24999 - sinIndex])]);
          break;
        case 2:
          PORTD = pgm_read_byte(&reverse[0x7F - pgm_read_byte(&sinLUT[sinIndex])]);
          break;
        case 3:
          PORTD = pgm_read_byte(&reverse[0x7F - pgm_read_byte(&sinLUT[24999 - sinIndex])]);
          break;
        }
      break;
    case 2: // triangle
      switch(quadrant){
        case 0:
          PORTD = pgm_read_byte(&reverse[int(sinIndex * triInc)]);
          break;
        case 1:
          PORTD = pgm_read_byte(&reverse[0xFF - int(sinIndex * triInc)]);
          break;
        case 2:
          PORTD = pgm_read_byte(&reverse[int(sinIndex * triInc)]);
          break;
        case 3:
          PORTD = pgm_read_byte(&reverse[0xFF - int(sinIndex * triInc)]);
          break;
        }
      break;
  }
}

void checkSettings() {
  
  if ( buttonRead() ){
    cli();
    holdInts();
    sei();
    updateLcdFunction();
    delay(5);
    cli();
    setInts();
    sei();
  }
  aState = digitalRead(ENCA);
  if ( aState != oldaState ){
    cli();
    holdInts();
    sei();
    getFreq();
    //delay(2);
    cli();
    setInts();
    sei();
  }
}

void loop()
{
  checkSettings(); // check the settings
}
